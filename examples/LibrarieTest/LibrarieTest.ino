#include <PocketPrinter.h>
#include <avr/pgmspace.h>

const uint8_t band0[640] PROGMEM = {
0x01, 0x00, 0x00, 0x00, 0x01, 0x00, 0x01, 0x00, 0x00, 0x00, 0x00, 0x00,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 0x00
};
const uint8_t band1[640] PROGMEM = {
0x00, 0x00, 0x00, 0x00, 0x00, 0x00, 0x00, 0x00, 0x00, 0x00, 0x00, 0x00,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 0x00
};
const uint8_t band2[640] PROGMEM = {
0x00, 0x00, 0x00, 0x00, 0x00, 0x00, 0x00, 0x00, 0x2F, 0x00, 0xDD, 0x22,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 0x00
};
const uint8_t band3[640] PROGMEM = {
0x3F, 0xFF, 0xFF, 0xFF, 0xFF, 0xFF, 0xFF, 0xFF, 0xFF, 0xFF, 0xFF, 0xFF,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 0xFF
};
const uint8_t band4[640] PROGMEM = {
0xFF, 0xFF, 0xFF, 0xFF, 0xFF, 0xFF, 0xFF, 0xFF, 0xFF, 0xFF, 0xFF, 0xFF,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 0xFF
};
const uint8_t band5[640] PROGMEM = {
0x00, 0xFF, 0x00, 0xFF, 0x00, 0xFF, 0x00, 0xFF, 0x00, 0xFF, 0x00, 0xFF,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 0xFB
};
const uint8_t band6[640] PROGMEM = {
0xBF, 0xFF, 0xBF, 0xFF, 0xBF, 0xFF, 0xBF, 0xFF, 0xBF, 0xFF, 0xBD, 0xFF,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 0xFF
};
const uint8_t band7[640] PROGMEM = {
0x31, 0xFF, 0xE7, 0xFF, 0xCF, 0xFF, 0x1C, 0xFF, 0x18, 0xFF, 0xB8, 0xFF,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 0x00
};
const uint8_t band8[640] PROGMEM = {
0x31, 0xFF, 0xE7, 0xFF, 0xCF, 0xFF, 0x1C, 0xFF, 0x18, 0xFF, 0xB8, 0xFF,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 0x00
};






PROGMEM const uint8_t * const bands[] = {band0, band1, band2, band3, band4, band5, band6, band7, band8};

const int bandNum = 9;

PocketPrinter printer(6, 5, 13);

void setup() {
  printer.POCKETPRINTER_DEBUG = 1;
  Serial.begin(9600);
  while (!Serial) {}
}

void loop() {
  if (Serial.available() > 0) {
    char code = Serial.read();
    if (code == 'p') {
      print();
    } else if (code == '?') {
      printer.SendInit();
      uint16_t  reply = printer.SendInquiry();
      bool b1 = printer.CheckAcknowledgement(highByte(reply));
      bool b2 = printer.CheckFatalError(lowByte(reply));
      Serial.print(b1);
      Serial.println(b2);
    }
  }
}

void print() {
  printer.SendInit();

  uint8_t buffer[640];
  for (int j = 0; j < bandNum; j++) {
    for (int i = 0; i < 640; i++) {
      buffer[i] = pgm_read_byte(pgm_read_word(bands + j) + i);
    }
    printer.SendData(buffer, 640);
  }
  printer.SendDataEnd();
  printer.SendPrint(1, 3, 0x5F);
  printer.WaitPrinting();
}
